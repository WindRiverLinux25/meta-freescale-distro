## conf/layer.conf
```bitbake
# We have a conf and classes directory, add to BBPATH
BBPATH .= ":${LAYERDIR}"

BSP_NXP_DERIVED ??= ""
# We have a packages directory, add to BBFILES
BBFILES += "${@bb.utils.contains_any('MACHINE', '${BSP_NXP_DERIVED}', '${LAYERDIR}/recipes-*/*/*.bb', '', d)}"
BBFILES += "${@bb.utils.contains_any('MACHINE', '${BSP_NXP_DERIVED}', '${LAYERDIR}/recipes-*/*/*.bbappend', '', d)}"

BBFILE_COLLECTIONS += "freescale-distro"
BBFILE_PATTERN_freescale-distro := "^${LAYERDIR}/"
BBFILE_PRIORITY_freescale-distro = "4"

LAYERDEPENDS_freescale-distro = "core yocto"

RECIPE_LIST_REASON:freescale-distro = "You are about to enable third-party components, there is additional third-part licensing involved, and you might need to consult with your legal department."

LAYERSERIES_COMPAT_freescale-distro = "styhead walnascar"
```
